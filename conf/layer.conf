## conf/layer.conf
```bitbake
#
#   Copyright 2021-2023 NXP
#   Configuration file for meta-rsdk layer
#
BBPATH .= ":${LAYERDIR}"

# add all defined bb files to the dictionary
BBFILES += "${LAYERDIR}/recipes-*/*/*.bb \
            ${LAYERDIR}/recipes-*/*/*.bbappend \
            ${LAYERDIR}/packagegroups/*.bb \
"

# add the other layer build parameters
BBFILE_COLLECTIONS += "meta-rsdk"
BBFILE_PATTERN_meta-rsdk = "^${LAYERDIR}/"
BBFILE_PRIORITY_meta-rsdk = "6"

# add the dependencies
LAYERDEPENDS_meta-rsdk = "core"
LAYERSERIES_COMPAT_meta-rsdk = "zeus gatesgarth kirkstone"

# add the license file
RSDK_EULA_FILE = "${LAYERDIR}/EULA"

# add the modules to the image
IMAGE_INSTALL:append = "\
    osal-driver \
    csi2-driver \
    cte-driver \
    lax-driver \
    spt-driver \
    spi-driver \
"
```
